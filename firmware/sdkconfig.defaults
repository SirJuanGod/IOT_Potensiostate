## firmware/sdkconfig.defaults
```kconfig
CONFIG_FREERTOS_HZ=1000
CONFIG_ESPTOOLPY_FLASHSIZE_2MB=y
CONFIG_MQTT_BUFFER_SIZE=4096
CONFIG_FREERTOS_TASK_NOTIFICATION_ARRAY_ENTRIES=2
CONFIG_PARTITION_TABLE_SINGLE_APP_LARGE=y
```

## firmware/src/Kconfig.projbuild
```kconfig
menu "Potenciostato"

    config PS_WIFI_SSID
        string "SSID de WiFi"
        default ""

    config PS_WIFI_PASSWORD
        string "Contraseña de WiFi"
        default ""

    config PS_MQTT_URI
        string "URI del broker MQTT"
        default "mqtt://broker.hivemq.com"

    config PS_DEVICE_ID
        string "ID del dispositivo (prefijo de topics)"
        default "ps01"

    config PS_DAC_VREF_MV
        int "Referencia del AD5662 (mV)"
        range 1500 5000
        default 3300

endmenu
```
